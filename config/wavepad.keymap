#include <behaviors.dtsi>
#include <dt-bindings/zmk/keys.h>

/ {
    keymap {
        compatible = "zmk,keymap";

        default_layer {
            bindings = <
&kp ENTER  &kp KP_NUMBER_7  &kp KP_NUMBER_8  &kp KP_NUMBER_9  &kp KP_PLUS  &kp KP_NUMBER_4  &kp KP_N5  &kp KP_NUMBER_6  &kp KP_MINUS  &kp KP_N3  &kp KP_NUMBER_2  &kp KP_N1  &kp KP_EQUAL  &kp KP_DOT  &kp KP_NUMBER_0  &kp BSPC
            >;

            sensor-bindings = <&inc_dec_kp C_VOL_UP C_VOL_DN>;
        };
    };
};
